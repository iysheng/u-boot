## arch/arm/cpu/armv7m/Kconfig
```kconfig
menu "sysTick Timer Support"

config SYS_ARCH_TIMER
        bool "STM32F7 timer support"
	help
	  Select this to enable support for the systick timer found on STM32 devices.

endmenu
```
